## conf/bblayers.conf
```bitbake
# POKY_BBLAYERS_CONF_VERSION is increased each time build/conf/bblayers.conf
# changes incompatibly
POKY_BBLAYERS_CONF_VERSION = "2"

BBPATH = "${TOPDIR}"
BBFILES ?= ""

BBLAYERS ?= " \
  /home/vasuper/Projects/yocto/sources/poky-amd-kirkstone/meta \
  /home/vasuper/Projects/yocto/sources/poky-amd-kirkstone/meta-poky \
  /home/vasuper/Projects/yocto/sources/poky-amd-kirkstone/meta-yocto-bsp \
  /home/vasuper/Projects/yocto/sources/poky-amd-kirkstone/meta-openembedded/meta-oe \
  /home/vasuper/Projects/yocto/sources/poky-amd-kirkstone/meta-openembedded/meta-python \
  /home/vasuper/Projects/yocto/sources/poky-amd-kirkstone/meta-openembedded/meta-networking \
  /home/vasuper/Projects/yocto/sources/poky-amd-kirkstone/meta-amd/meta-amd-distro \
  /home/vasuper/Projects/yocto/sources/poky-amd-kirkstone/meta-amd/meta-amd-bsp \
  /home/vasuper/Projects/yocto/sources/poky-amd-kirkstone/meta-aws \
  "
```

## conf/local.conf
```bitbake
DL_DIR ?= "${TOPDIR}/../downloads"
SSTATE_DIR ?= "${TOPDIR}/../sstate-cache"

MACHINE = "v1000"
DISTRO = "poky-amd"
```
